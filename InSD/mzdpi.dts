/dts-v1/;

/ {
	compatible = "brcm,bcm2708";

	fragment@0 {
		target = <0xdeadbeef>;

		__overlay__ {
			pinctrl-names = "default";
			pinctrl-0 = <0x1>;
		};
	};

	fragment@1 {
		target = <0xdeadbeef>;

		__overlay__ {

			dpi18_pins {
				brcm,pins = <0x0 0x1 0x2 0x3 0x4 0x5 0x6 0xc 0xd 0xe 0xf 0x10 0x11 0x14 0x15 0x16 0x17 0x18>;
				brcm,function = <0x6 0x6 0x6 0x6 0x6 0x6 0x6 0x6 0x6 0x6 0x6 0x6 0x6 0x6 0x6 0x6 0x6 0x6>;
				brcm,pull = <0x1>;
				linux,phandle = <0x1>;
				phandle = <0x1>;
			};
		};
	};

	__symbols__ {
		dpi18_pins = "/fragment@1/__overlay__/dpi18_pins";
	};

	__fixups__ {
		leds = "/fragment@0:target:0";
		gpio = "/fragment@1:target:0";
	};

	__local_fixups__ {
		fixup = "/fragment@0/__overlay__:pinctrl-0:0";
	};
};
